## examples/default/main/Kconfig.projbuild
```kconfig
menu "Example configuration"

    config EXAMPLE_USING_MIDDLE_RANGE_CONTROL
        bool "Use middle-range control"
        default true
        help
            Use middle-range control in the example. TDA7439DS supports
            middle-range control, TDA7440 does not. Select this if the chip
            supports middle-range control.

    config EXAMPLE_INPUT_CHANNEL
        int "Input to use, from 1 to 4"
        range 1 4
        default 2
        help
            Number of the input of the input selector, as it is marked on the
            board: 1 is IN1 and 4 is IN4. The chip powers up with IN2.

    config EXAMPLE_INPUT_GAIN
        int "Input gain, from 0 to 30"
        range 0 30
        default 28
        help
            Input gain in dB at 2 dB step, so only even values are valid.

    config EXAMPLE_VOLUME
        int "The volume control in dB, from -47 to 0"
        range -47 0
        default 0
        help
            The volume control in dB at 1 dB step. The chip has no level below
            -47 dB: the output is muted instead, see tda74xx_set_volume_mute().

    config EXAMPLE_BASS
        int "Bass control in dB, from -14 to 14"
        range -14 14
        default 0
        help
            Bass control in dB at 2 dB step, so only even values are valid.

    config EXAMPLE_MIDDLE
        int "Middle-range control in dB, from -14 to 14"
        range -14 14
        default 0
        help
            Middle-range control in dB at 2 dB step, so only even values are
            valid.
        depends on EXAMPLE_USING_MIDDLE_RANGE_CONTROL

    config EXAMPLE_TREBLE
        int "Treble control in dB, from -14 to 14"
        range -14 14
        default 0
        help
            Treble control in dB at 2 dB step, so only even values are valid.

    rsource "../../../Kconfig.i2c"
endmenu
```
